## v1/sw/sdkconfig.defaults
```kconfig
# Generic
CONFIG_ESP_DEFAULT_CPU_FREQ_MHZ_160=y
CONFIG_COMPILER_OPTIMIZATION_SIZE=y

# BT Controller: dual mode, pinned to core 0
CONFIG_BT_ENABLED=y
CONFIG_BTDM_CTRL_MODE_BTDM=y
CONFIG_BTDM_CTRL_PINNED_TO_CORE_0=y
CONFIG_BTDM_CTRL_BR_EDR_MAX_ACL_CONN=4
CONFIG_BTDM_CTRL_BLE_MAX_CONN=4
CONFIG_BT_ACL_CONNECTIONS=8
CONFIG_BT_BTU_TASK_STACK_SIZE=6144
CONFIG_BTDM_CTRL_MODEM_SLEEP=n

# Bluedroid host stack, pinned to core 0
CONFIG_BT_BLUEDROID_ENABLED=y
CONFIG_BT_BLUEDROID_PINNED_TO_CORE_0=y
CONFIG_BT_CLASSIC_ENABLED=y
CONFIG_BT_BLE_ENABLED=y

# HID Host
CONFIG_BT_HID_ENABLED=y
CONFIG_BT_HID_HOST_ENABLED=y

# BLE features
CONFIG_BT_BLE_42_FEATURES_SUPPORTED=y
CONFIG_BT_GATTC_NOTIF_REG_MAX=16

# ESP_HID (patch)
# CONFIG_ESPHID_TASK_AFFINITY_CPU0=y

# Bonding
CONFIG_BT_SMP_MAX_BONDS=8

# Most tasks on core 0
CONFIG_ESP_MAIN_TASK_AFFINITY_CPU0=y
#CONFIG_ESP_TIMER_TASK_AFFINITY_CPU0=y
#CONFIG_ESP_TIMER_ISR_AFFINITY_CPU0=y
#CONFIG_FREERTOS_TIMER_TASK_AFFINITY_CPU0=y
#CONFIG_LWIP_TCPIP_TASK_AFFINITY_CPU0=y
#CONFIG_PTHREAD_TASK_CORE_DEFAULT=0
#CONFIG_PTHREAD_DEFAULT_CORE_0=y

# Partition
CONFIG_ESPTOOLPY_FLASHSIZE_8MB=y
CONFIG_PARTITION_TABLE_SINGLE_APP_LARGE=y
```
